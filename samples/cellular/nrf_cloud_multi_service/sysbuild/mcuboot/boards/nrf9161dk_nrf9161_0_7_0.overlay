/*
 * Copyright (c) 2023 Nordic Semiconductor ASA
 *
 * SPDX-License-Identifier: LicenseRef-Nordic-5-Clause
 */

/ {
	chosen {
		zephyr,code-partition = &boot_partition;
	};
};

#include "../../../boards/nrf9161dk_nrf9161_ns_0_7_0.overlay"
