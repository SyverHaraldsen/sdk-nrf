## boards/nordic/nrf93m1dk/Kconfig
```kconfig
# Copyright (c) 2025 Nordic Semiconductor ASA
# SPDX-License-Identifier: LicenseRef-Nordic-5-Clause

# nRF93M1DK board configuration

if BOARD_NRF93M1DK_NRF54L15_CPUAPP_NS

DT_NRF_MPC := $(dt_nodelabel_path,nrf_mpc)

config NRF_TRUSTZONE_FLASH_REGION_SIZE
	hex
	default $(dt_node_int_prop_hex,$(DT_NRF_MPC),override-granularity)
	help
	  This defines the flash region size from the TrustZone perspective.
	  It is used when configuring the TrustZone and when setting alignments
	  requirements for the partitions.
	  This abstraction allows us to configure TrustZone without depending
	  on peripheral-specific symbols.

config NRF_TRUSTZONE_RAM_REGION_SIZE
	hex
	default $(dt_node_int_prop_hex,$(DT_NRF_MPC),override-granularity)
	help
	  This defines the RAM region size from the TrustZone perspective.
	  It is used when configuring the TrustZone and when setting alignments
	  requirements for the partitions.
	  This abstraction allows us to configure TrustZone without depending
	  on peripheral specific symbols.

endif # BOARD_NRF93M1DK_NRF54L15_CPUAPP_NS

if (BOARD_REVISION_V0_2 || BOARD_REVISION_V0_3)

config BOARD_MODEM_UART_BYPASS
	bool "Enable Modem UART Bypass"
	help
	  Enable modem UART bypass feature available on revision v0.2 of the board.
	  This routes the modem UART directly to the USB interface, bypassing the
	  nRF54 CPU UART peripheral.

endif # BOARD_REVISION_V0_2 or V0_3

config BOARD_POWER_MODEM_ON_BOOT
	bool "Toggle Modem Powerkey on Boot"
	help
	  Toggle nRF93M1 modem's power key on boot. This allows booting up the
	  modem when nRF54 boots up.

config BOARD_MODEM_POWER_EN_DELAY_MS
	int "Delay for enabling the DC switch for modem (ms)"
	default 0
	help
	  Delay in milliseconds for enabling the DC switch for modem on boot.
	  This is to prevent too high inrush current when USB is connected and
	  modem is powered on at the same time.

config BOARD_MODEM_BOOT_DELAY_MS
	int "Delay before toggling the power key (ms)"
	default 0
	help
	  Delay in milliseconds before toggling the power key after enabling
	  the DC switch for modem on boot.
	  This requires modem firmware with power key debounche configured.
```

## boards/nordic/nrf93m1dk/Kconfig.defconfig
```kconfig
# Copyright (c) 2025 Nordic Semiconductor ASA
# SPDX-License-Identifier: LicenseRef-Nordic-5-Clause

config HW_STACK_PROTECTION
	default ARCH_HAS_STACK_PROTECTION

if BOARD_NRF93M1DK_NRF54L15_CPUAPP

config ROM_START_OFFSET
	default 0 if PARTITION_MANAGER_ENABLED
	default 0x800 if BOOTLOADER_MCUBOOT

endif # BOARD_NRF93M1DK_NRF54L15_CPUAPP

if BOARD_NRF93M1DK_NRF54L15_CPUAPP_NS

config BOARD_NRF93M1DK
	select USE_DT_CODE_PARTITION if BOARD_NRF93M1DK_NRF54L15_CPUAPP_NS || \
		BOARD_NRF93M1DK_NRF54L10_CPUAPP_NS

# By default, if we build for a Non-Secure version of the board,
# enable building with TF-M as the Secure Execution Environment.
config BUILD_WITH_TFM
	default y

# If building with TF-M, disable UART in TF-M to avoid conflicts with
# the UART used by the modem
if BUILD_WITH_TFM
config TFM_SECURE_UART
	default n
config TFM_LOG_LEVEL_SILENCE
	default n

endif # BUILD_WITH_TFM

endif # BOARD_NRF93M1DK_NRF54L15_CPUAPP_NS
```

## boards/nordic/nrf93m1dk/Kconfig.nrf93m1dk
```kconfig
# Copyright (c) 2025 Nordic Semiconductor ASA
# SPDX-License-Identifier: LicenseRef-Nordic-5-Clause

config BOARD_NRF93M1DK
	select SOC_NRF54L15_CPUAPP if BOARD_NRF93M1DK_NRF54L15_CPUAPP || BOARD_NRF93M1DK_NRF54L15_CPUAPP_NS
	select SOC_NRF54L15_CPUFLPR if BOARD_NRF93M1DK_NRF54L15_CPUFLPR || \
					    BOARD_NRF93M1DK_NRF54L15_CPUFLPR_XIP
```

## boards/nordic/nrf93m1dk/board.yml
```yaml
board:
  name: nrf93m1dk
  full_name: nRF93M1 DK
  vendor: nordic
  revision:
    format: custom
    default: v0.3
    exact: true
    revisions:
    - name: v0.1
    - name: v0.2
    - name: v0.3
  socs:
    - name: nrf54l15
      variants:
        - name: xip
          cpucluster: cpuflpr
        - name: ns
          cpucluster: cpuapp
runners:
  run_once:
    '--recover':
      - runners:
          - nrfjprog
          - nrfutil
        run: first
        groups:
          - boards:
              - nrf93m1dk/nrf54l15/cpuapp
              - nrf93m1dk/nrf54l15/cpuapp/ns
              - nrf93m1dk/nrf54l15/cpuflpr
              - nrf93m1dk/nrf54l15/cpuflpr/xip
    '--erase':
      - runners:
          - nrfjprog
          - jlink
          - nrfutil
        run: first
        groups:
          - boards:
              - nrf93m1dk/nrf54l15/cpuapp
              - nrf93m1dk/nrf54l15/cpuapp/ns
              - nrf93m1dk/nrf54l15/cpuflpr
              - nrf93m1dk/nrf54l15/cpuflpr/xip
    '--reset':
      - runners:
          - nrfjprog
          - jlink
          - nrfutil
        run: last
        groups:
          - boards:
              - nrf93m1dk/nrf54l15/cpuapp
              - nrf93m1dk/nrf54l15/cpuapp/ns
              - nrf93m1dk/nrf54l15/cpuflpr
              - nrf93m1dk/nrf54l15/cpuflpr/xip
```

## boards/nordic/nrf93m1dk/dts/bindings/nordic,nrf93m1dk-modem-control.yaml
```yaml
# Copyright (c) 2026 Nordic Semiconductor ASA
# SPDX-License-Identifier: Apache-2.0

description: GPIO lines for controlling the modem on nRF93M1 DK board

compatible: "nordic,nrf93m1dk-modem-control"

include: base.yaml

properties:
  status:
    required: true

  dcdc-en-gpios:
    type: phandle-array
    description: |
      GPIO for enabling the DC/DC regulator that powers the modem.

  vcom1-ctl-gpios:
    type: phandle-array
    description: |
      GPIO for controlling the UART bypass switch.

  modem-reset-gpios:
    type: phandle-array
    required: true
    description: |
      nRF93M1 modem reset GPIO.

  modem-powerkey-gpios:
    type: phandle-array
    required: true
    description: |
      GPIO for controlling the modem power key.

  modem-usb-boot-gpios:
    type: phandle-array
    description: |
      GPIO for controlling the modem USB boot mode.
```

## boards/nordic/nrf93m1dk/nrf93m1dk_nrf54l15_cpuapp_defconfig
```kconfig
# Copyright (c) 2025 Nordic Semiconductor ASA
# SPDX-License-Identifier: LicenseRef-Nordic-5-Clause

# Enable UART driver
CONFIG_SERIAL=y

# Enable console
CONFIG_CONSOLE=y
CONFIG_UART_CONSOLE=y

# Enable GPIO
CONFIG_GPIO=y

# Enable MPU
CONFIG_ARM_MPU=y

CONFIG_I2C=y
CONFIG_REGULATOR=y
CONFIG_REGULATOR_NPM13XX=y
CONFIG_SENSOR=y
CONFIG_CHARGER=y
CONFIG_NPM13XX_CHARGER=y
```

## boards/nordic/nrf93m1dk/nrf93m1dk_nrf54l15_cpuapp_v0_3_defconfig
```kconfig
# DK v0.3 does not have an external 32kHz crystal
# Use the internal RC oscillator instead
CONFIG_CLOCK_CONTROL_NRF_K32SRC_RC=y
```

## samples/cellular/http_update/application_update/boards/nrf9151dk_nrf9151_ns.conf
```kconfig
#
# Copyright (c) 2024 Nordic Semiconductor ASA
#
# SPDX-License-Identifier: LicenseRef-Nordic-5-Clause
#

# Sample configuration
CONFIG_DOWNLOAD_HOST="syver-nrf-delta-fota.s3.eu-central-1.amazonaws.com"
CONFIG_DOWNLOAD_FILE_V1="app_v1.bin"
CONFIG_DOWNLOAD_FILE_V2="app_v2.bin"
CONFIG_APPLICATION_VERSION=1

CONFIG_AT_SHELL=y
```
