/*
 * Copyright (c) 2025 Nordic Semiconductor ASA
 *
 * SPDX-License-Identifier: LicenseRef-Nordic-5-Clause
 */

/dts-v1/;

#include <nordic/nrf54l15_cpuapp.dtsi>
#include "nrf93m1dk_nrf54l15_cpuapp_common.dtsi"

/ {
	compatible = "nordic,nrf93m1dk_nrf54l15-cpuapp";
	model = "Nordic nRF93M1 EK nRF54L15 Application MCU";

	chosen {
		zephyr,code-partition = &slot0_partition;
		zephyr,sram = &cpuapp_sram;
	};
};

/* Workaround, because buttons are connected to NFC1 & NFC2 */
&uicr {
	nfct-pins-as-gpios;
};

/* Include default memory partition configuration file */
#include <vendor/nordic/nrf54l15_cpuapp_partition.dtsi>
